## conf/layer.conf
```bitbake
# We have a conf and classes directory, add to BBPATH
BBPATH .= ":${LAYERDIR}"

# We have recipes-* directories, add to BBFILES
BBFILES += "${LAYERDIR}/recipes-*/*/*.bb \
	${LAYERDIR}/recipes-*/*/*.bbappend"

BBFILE_COLLECTIONS += "arb2"
BBFILE_PATTERN_arb2 = "^${LAYERDIR}/"
BBFILE_PRIORITY_arb2 = "6"
```

## conf/machine/arb2.conf
```bitbake
#@TYPE: Machine
#@NAME: ARB2
#@SOC: i.MX6DL
#@DESCRIPTION: Machine configuration for ARB2
#@MAINTAINER: 

require conf/machine/include/imx6sabresd-common.inc

SOC_FAMILY = "mx6:mx6dl"

KERNEL_DEVICETREE = "imx6dl-arb2.dtb"

UBOOT_MACHINE ??= "arb2_defconfig"

SERIAL_CONSOLE = "115200 ttymxc4"
```
